## CMakeLists.txt
```
cmake_minimum_required(VERSION 3.20.0)
find_package(Zephyr REQUIRED HINTS $ENV{ZEPHYR_BASE})
project(Sensor_Data)

FILE(GLOB app_sources src/*.c)
target_sources(app PRIVATE ${app_sources})
```

## prj.conf
```kconfig
CONFIG_MAIN_STACK_SIZE=4096

CONFIG_I2C=y
CONFIG_SENSOR=y
CONFIG_CBPRINTF_FP_SUPPORT=y
CONFIG_LOG=y

CONFIG_FLASH=y
CONFIG_FLASH_MAP=y
CONFIG_FILE_SYSTEM=y
CONFIG_FILE_SYSTEM_LITTLEFS=y
```

## src/main.c
```c
/**
 * @file main.c
 * @brief Main module for logger initialization.
 *
 * This module initalizes the mounting and logging
 * the sensor data from respective sensors to the 
 * files in Little FS.
 *
 * @date 15-08-2025
 * @author Parthrajsinh Vala
*/

//==============================================================================
// Includes
//==============================================================================

#include "hum_temp_sensor.h"
#include "imu_sensor.h"
#include "pressure_sensor.h"
#include "sensor_shared.h"
#include "sensor_storage.h"
#include <zephyr/kernel.h>
#include <zephyr/sys/util.h>
#include <zephyr/logging/log.h>
#include <stdbool.h>

//==============================================================================
// Configuration Constants
//==============================================================================

/**
 * @brief Generic thread configuration.
 *
 * Defines the default stack size, priority, and sleep interval
 * for standard threads handling sensor operations.
*/

#define STACK_SIZE         1024         // Default stack size for generic threads
#define PRIORITY           5            // Default thread priority
#define SLEEP_TIME         K_SECONDS(5) // Delay between sensor operations

/**
 * @brief Storage thread configuration.
 *
 * Defines the stack size, priority, and execution interval
 * for the thread responsible for writing sensor data to storage.
*/

#define STORAGE_STACK_SIZE (1024 * 4)   // Stack size for storage thread
#define STORAGE_PRIORITY   4            // Thread priority for storage task
#define STORAGE_INTERVAL   K_MINUTES(1) // Interval for storing sensor data

/**
 * @brief Reader thread configuration.
 *
 * Defines the stack size, priority, and execution interval
 * for the thread responsible for reading stored sensor data.
*/

#define READER_STACK_SIZE  1024         // Stack size for reader thread
#define READER_PRIORITY    5            // Thread priority for reader task
#define READER_INTERVAL    K_MINUTES(2) // Interval for reading stored data

/**
 * @brief Thread stack memory definitions.
 *
 * Defines dedicated stack areas for all sensor, storage, and reader threads.
 * Stack sizes are determined by the corresponding configuration macros.
*/

K_THREAD_STACK_DEFINE(hum_temp_stack, STACK_SIZE);       // Humidity & temperature sensor thread stack
K_THREAD_STACK_DEFINE(pressure_stack, STACK_SIZE);       // Pressure sensor thread stack
K_THREAD_STACK_DEFINE(imu_stack, STACK_SIZE);            // IMU (accelerometer/gyroscope) sensor thread stack
K_THREAD_STACK_DEFINE(storage_stack, STORAGE_STACK_SIZE); // Storage thread stack
K_THREAD_STACK_DEFINE(reader_stack, READER_STACK_SIZE);   // Reader thread stack


/**
 * @brief Thread control structures, IDs, and termination flags.
 *
 * Each sensor and system task has its own thread data, thread ID,
 * and a termination flag used to signal graceful shutdown.
*/

static struct k_thread hum_temp_thread_data;      // Humidity & temperature sensor thread control block
static struct k_thread pressure_thread_data;      // Pressure sensor thread control block
static struct k_thread imu_thread_data;           // IMU (accelerometer/gyroscope) sensor thread control block
static struct k_thread storage_thread_data;       // Storage thread control block
static struct k_thread reader_thread_data;        // Reader thread control block

static k_tid_t hum_temp_tid, pressure_tid, imu_tid, storage_tid, reader_tid; // Thread IDs for all tasks

static bool terminate_hum_temp_thread = false;    // Termination flag for humidity & temperature thread
static bool terminate_pressure_thread = false;    // Termination flag for pressure thread
static bool terminate_imu_thread = false;         // Termination flag for IMU thread
static bool terminate_storage_thread = false;     // Termination flag for storage thread
static bool terminate_reader_thread = false;      // Termination flag for reader thread

//==============================================================================
// Logging Module Register
//==============================================================================

LOG_MODULE_REGISTER(main);

//==============================================================================
// Function Definitions
//==============================================================================

/**
 * @brief Humidity & Temperature sensor thread.
 *
 * This thread periodically fetches humidity and temperature samples
 * from the sensor by calling hum_temp_sensor_process_sample().
 * The thread runs until its termination flag is set, sleeping for
 * @ref SLEEP_TIME between each sample.
 *
 * @param a Unused thread parameter.
 * @param b Unused thread parameter.
 * @param c Unused thread parameter.
 *
 * @return void
*/

static void hum_temp_sensor_thread(void *a, void *b, void *c)
{
    LOG_INF("Humidity-Temperature sensor thread started.");

    while (!terminate_hum_temp_thread) {
        hum_temp_sensor_process_sample();
        k_sleep(SLEEP_TIME);
    }

    LOG_INF("Humidity-Temperature sensor thread stopped.");
}

/**
 * @brief Thread handler for the pressure sensor.
 *
 * This thread continuously reads pressure data from the sensor
 * by invoking pressure_sensor_process_sample(). It runs in a loop
 * until the termination flag @ref terminate_pressure_thread is set.
 *
 * The thread sleeps for @ref SLEEP_TIME between sensor reads
 * to control sampling frequency.
 *
 * @param a Unused thread parameter (reserved for Zephyr API).
 * @param b Unused thread parameter (reserved for Zephyr API).
 * @param c Unused thread parameter (reserved for Zephyr API).
 *
 * @return void
*/

static void pressure_sensor_thread(void *a, void *b, void *c)
{
    LOG_INF("Pressure sensor thread started.");

    while (!terminate_pressure_thread) {
        pressure_sensor_process_sample();
        k_sleep(SLEEP_TIME);
    }

    LOG_INF("Pressure sensor thread stopped.");
}

/**
 * @brief Thread function for IMU sensor sampling and processing.
 *
 * This thread continuously processes IMU sensor samples at a fixed interval
 * until the termination flag is set. Once the termination condition is met,
 * the thread exits gracefully.
 *
 * @param a Unused thread parameter.
 * @param b Unused thread parameter.
 * @param c Unused thread parameter.
 *
 * @note Uses the global variable @c terminate_imu_thread as the stop condition.
 * @note Calls @c imu_sensor_sample_process() for each iteration.
*/

static void imu_sensor_thread(void *a, void *b, void *c)
{
    LOG_INF("IMU sensor thread started.");

    while (!terminate_imu_thread) {
        imu_sensor_sample_process();
        k_sleep(SLEEP_TIME);
    }

    LOG_INF("IMU sensor thread stopped.");
}

/**
 * @brief Thread handler for storing sensor data.
 *
 * This thread periodically saves the latest sensor readings
 * to persistent storage using littlefs_save_sensor_data().
 * Access to the shared @ref sensor_data structure is protected
 * with a mutex during storage operations.
 *
 * The thread runs until the termination flag
 * @ref terminate_storage_thread is set, sleeping for
 * @ref STORAGE_INTERVAL between write operations.
 *
 * @param a Unused thread parameter (reserved for Zephyr API).
 * @param b Unused thread parameter (reserved for Zephyr API).
 * @param c Unused thread parameter (reserved for Zephyr API).
 *
 * @return void
*/

static void sensor_storage_thread(void *a, void *b, void *c)
{
    LOG_INF("Sensor storage thread started.");

    while (!terminate_storage_thread) {
        k_mutex_lock(&sensor_data_mutex, K_FOREVER);
        littlefs_save_sensor_data(&sensor_data);
        k_mutex_unlock(&sensor_data_mutex);
        k_sleep(STORAGE_INTERVAL);
    }

    LOG_INF("Sensor storage thread stopped.");
}

/**
 * @brief Thread handler for reading stored sensor data.
 *
 * This thread periodically retrieves sensor data from
 * persistent storage using littlefs_read_sensor_data().
 *
 * The thread runs until the termination flag
 * @ref terminate_reader_thread is set, sleeping for
 * @ref READER_INTERVAL between read operations.
 *
 * @param a Unused thread parameter (reserved for Zephyr API).
 * @param b Unused thread parameter (reserved for Zephyr API).
 * @param c Unused thread parameter (reserved for Zephyr API).
 *
 * @return void
*/

static void reader_thread(void *a, void *b, void *c)
{
    LOG_INF("Reader thread started.");

    while (!terminate_reader_thread) {
        littlefs_read_sensor_data();
        k_sleep(READER_INTERVAL);
    }

    LOG_INF("Reader thread stopped.");
}

/**
 * @brief Main entry point of the application.
 *
 * This function initializes the global sensor data mutex,
 * sets up all sensor devices, and creates the required
 * threads for sensor data acquisition, storage, and reading.
 *
 * The following threads are started:
 * - Humidity & Temperature sensor thread
 * - Pressure sensor thread
 * - IMU sensor thread
 * - Sensor storage thread
 * - Reader thread
 *
 * Each thread runs independently until its corresponding
 * termination flag is set.
 *
 * @return 0 on success, negative error code otherwise.
*/

int main(void)
{
    int ret;

    k_mutex_init(&sensor_data_mutex);

    /* Initialize sensors */
    ret = hum_temp_sensor_init();
    if (ret < 0) {
        LOG_ERR("Humidity-Temperature Sensor init failed");
    }

    ret = pressure_sensor_init();
    if (ret < 0) {
        LOG_ERR("Pressure Sensor init failed");
    }

    ret = imu_sensor_init();
    if (ret < 0) {
        LOG_ERR("IMU Sensor init failed");
    }

    /* Start sensor threads */
    terminate_hum_temp_thread = false;
    hum_temp_tid = k_thread_create(&hum_temp_thread_data, hum_temp_stack, K_THREAD_STACK_SIZEOF(hum_temp_stack),
                                   hum_temp_sensor_thread, NULL, NULL, NULL, PRIORITY, 0, K_NO_WAIT);

    terminate_pressure_thread = false;
    pressure_tid = k_thread_create(&pressure_thread_data, pressure_stack, K_THREAD_STACK_SIZEOF(pressure_stack),
                                   pressure_sensor_thread, NULL, NULL, NULL, PRIORITY, 0, K_NO_WAIT);

    terminate_imu_thread = false;
    imu_tid = k_thread_create(&imu_thread_data, imu_stack, K_THREAD_STACK_SIZEOF(imu_stack),
                              imu_sensor_thread, NULL, NULL, NULL, PRIORITY, 0, K_NO_WAIT);

    /* Start storage thread */
    terminate_storage_thread = false;
    storage_tid = k_thread_create(&storage_thread_data, storage_stack, K_THREAD_STACK_SIZEOF(storage_stack),
                                  sensor_storage_thread, NULL, NULL, NULL, STORAGE_PRIORITY, 0, K_NO_WAIT);
                
    /* Start reader thread */
    terminate_reader_thread = false;
    reader_tid = k_thread_create(&reader_thread_data, reader_stack, K_THREAD_STACK_SIZEOF(reader_stack),
                             reader_thread, NULL, NULL, NULL, READER_PRIORITY, 0, K_NO_WAIT);

    return 0;
}
```

## src/hum_temp_sensor.c
```c
/**
 * @file hum_temp_sensor.c
 * @brief Humidity and Temperature Sensor Processing Module.
 *
 * This module provides functionality to fetch and process data
 * from the onboard HTS221 (or equivalent) humidity/temperature sensor
 * using Zephyr's sensor API.
 *
 * @date 15-08-2025
 * @author Parthrajsinh Vala
*/

//==============================================================================
// Includes
//==============================================================================

#include <zephyr/device.h>
#include <zephyr/drivers/sensor.h>
#include <zephyr/kernel.h>
#include <zephyr/logging/log.h>
#include <zephyr/sys/util.h>
#include "hum_temp_sensor.h"
#include "sensor_shared.h"

//==============================================================================
// Logging Module Register
//==============================================================================

LOG_MODULE_REGISTER(hum_temp);

//==============================================================================
// Device Tree Bindings
//==============================================================================

#if DT_NODE_EXISTS(DT_ALIAS(ht_sensor))
#define HUM_TEMP_NODE DT_ALIAS(ht_sensor)
const struct device *const hts_dev = DEVICE_DT_GET(DT_ALIAS(ht_sensor));
#else
#error ("Humidity-Temperature sensor not found.");
#endif

//==============================================================================
// Function Definitions
//==============================================================================

/**
 * @brief Process a humidity and temperature sample from the HTS221 sensor.
 *
 * This function verifies that the sensor device is ready, fetches the
 * latest measurement, and retrieves both temperature and humidity values.
 * The values are converted to floating-point and stored in the shared
 * sensor_data structure (protected by a mutex).
 *
 * @note Error conditions are logged but not propagated to the caller.
 *
 * @return void
*/


void hum_temp_sensor_process_sample(void)
{
    if (!device_is_ready(hts_dev)) {
        LOG_ERR("sensor: %s device not ready.", hts_dev->name);
        return;
    }

    if (sensor_sample_fetch(hts_dev) < 0) {
        LOG_ERR("Sensor sample update error");
        return;
    }

    struct sensor_value temp, hum;
    if (sensor_channel_get(hts_dev, SENSOR_CHAN_AMBIENT_TEMP, &temp) < 0) {
        LOG_ERR("Cannot read HTS221 temperature channel");
        return;
    }

    if (sensor_channel_get(hts_dev, SENSOR_CHAN_HUMIDITY, &hum) < 0) {
        LOG_ERR("Cannot read HTS221 humidity channel");
        return;
    }

    k_mutex_lock(&sensor_data_mutex, K_FOREVER);
    sensor_data.temperature = sensor_value_to_double(&temp);
    sensor_data.humidity = sensor_value_to_double(&hum);
    k_mutex_unlock(&sensor_data_mutex);

    /* display temperature */
    //LOG_INF("Temperature:%.1f C", sensor_value_to_double(&temp));

    /* display humidity */
    //LOG_INF("Relative Humidity:%.1f%%", sensor_value_to_double(&hum));
}

/**
 * @brief Initialize the HTS221 humidity and temperature sensor.
 *
 * This function checks whether the sensor device is ready for use.
 * If the device is available, it triggers an initial sample fetch
 * using hum_temp_sensor_process_sample() to populate sensor_data.
 *
 * @return  0  Success, sensor ready and initial sample processed.  
 *         -1  Failure, sensor device not ready.
*/


int hum_temp_sensor_init(void)
{
    if (!device_is_ready(hts_dev)) {
        LOG_ERR("sensor: %s device not ready.", hts_dev->name);
        return -1;
    }

    hum_temp_sensor_process_sample();

    return 0;
}
```

## src/hum_temp_sensor.h
```c
/**
 * @file hum_temp_sensor.h
 * @brief Humidity and Temperature Sensor Interface.
 *
 * This header provides function declarations for initializing and 
 * processing samples from a humidity and temperature sensor.
 *
 * @date 15-08-2025
 * @author Parthrajsinh Vala
*/

#ifndef HUM_TEMP_SENSOR_H
#define HUM_TEMP_SENSOR_H

/**
 * @brief Process a single sample from the humidity and temperature sensor.
 *
 * This function should be called whenever a new sensor reading is available.
 * It handles reading, processing, and possibly logging or storing the values.
*/

void hum_temp_sensor_process_sample(void);

/**
 * @brief Initialize the humidity and temperature sensor.
 *
 * Sets up the sensor device and prepares it for sampling.
 *
 * @return 0 on success, or a negative error code on failure.
*/

int hum_temp_sensor_init(void);

#endif /* HUM_TEMP_SENSOR_H */
```

## src/imu_sensor.c
```c
/**
 * @file imu_sensor.c
 * @brief IMU (Accelerometer + Gyroscope) sensor processing module.
 *
 * This module provides functionality to fetch and process data
 * from the onboard IMU (e.g., LSM6DSL) using Zephyr's sensor API.
 *
 * It extracts both acceleration (X, Y, Z) and gyroscope (X, Y, Z) readings
 * and stores them in a user-provided @ref three_d struct.
 *
 * @date 15-08-2025
 * @author Parthrajsinh Vala
*/

//==============================================================================
// Includes
//==============================================================================

#include "imu_sensor.h"
#include "sensor_shared.h"
#include <zephyr/device.h>
#include <zephyr/drivers/sensor.h>
#include <zephyr/kernel.h>
#include <zephyr/logging/log.h>
#include <zephyr/sys/util.h>

//==============================================================================
// Logging Module Register
//==============================================================================

LOG_MODULE_REGISTER(imu);

//==============================================================================
// Device Tree Bindings
//==============================================================================

#if DT_NODE_EXISTS(DT_ALIAS(imu_sensor))
#define IMU_NODE DT_ALIAS(imu_sensor)
const struct device *const imu_dev = DEVICE_DT_GET(DT_ALIAS(imu_sensor));
#else
#error ("IMU sensor not found.");
#endif

//==============================================================================
// Function Definitions
//==============================================================================

/**
 * @brief Process accelerometer and gyroscope samples from the IMU sensor.
 *
 * This function fetches the latest IMU sample data and reads values from both
 * the accelerometer and gyroscope channels. The raw sensor values are converted
 * to floating-point and stored in the shared sensor_data structure, protected
 * by a mutex to ensure thread safety.
 *
 * @note Error conditions are logged but not returned to the caller.
 *
 * @return void
*/

void imu_sensor_sample_process(void)
{
    if (sensor_sample_fetch(imu_dev) < 0) {
        LOG_ERR("Sensor sample update error");
        return;
    }
    char out_str[64];
    struct sensor_value accel_x, accel_y, accel_z;
    struct sensor_value gyro_x, gyro_y, gyro_z;

    /* lsm6dsl accel */
    sensor_sample_fetch_chan(imu_dev, SENSOR_CHAN_ACCEL_XYZ);
    sensor_channel_get(imu_dev, SENSOR_CHAN_ACCEL_X, &accel_x);
    sensor_channel_get(imu_dev, SENSOR_CHAN_ACCEL_Y, &accel_y);
    sensor_channel_get(imu_dev, SENSOR_CHAN_ACCEL_Z, &accel_z);

    sprintf(out_str, "accel x:%f ms/2 y:%f ms/2 z:%f ms/2", sensor_value_to_double(&accel_x),
            sensor_value_to_double(&accel_y), sensor_value_to_double(&accel_z));
    //LOG_INF("%s", out_str);

    k_mutex_lock(&sensor_data_mutex, K_FOREVER);
    sensor_data.accel_x = sensor_value_to_double(&accel_x);
    sensor_data.accel_y = sensor_value_to_double(&accel_y);
    sensor_data.accel_z = sensor_value_to_double(&accel_z);
    k_mutex_unlock(&sensor_data_mutex);

    /* lsm6dsl gyro */
    sensor_sample_fetch_chan(imu_dev, SENSOR_CHAN_GYRO_XYZ);
    sensor_channel_get(imu_dev, SENSOR_CHAN_GYRO_X, &gyro_x);
    sensor_channel_get(imu_dev, SENSOR_CHAN_GYRO_Y, &gyro_y);
    sensor_channel_get(imu_dev, SENSOR_CHAN_GYRO_Z, &gyro_z);

    sprintf(out_str, "gyro x:%f dps y:%f dps z:%f dps", sensor_value_to_double(&gyro_x),
            sensor_value_to_double(&gyro_y), sensor_value_to_double(&gyro_z));
    //LOG_INF("%s", out_str);

    k_mutex_lock(&sensor_data_mutex, K_FOREVER);
    sensor_data.gyro_x = sensor_value_to_double(&gyro_x);
    sensor_data.gyro_y = sensor_value_to_double(&gyro_y);
    sensor_data.gyro_z = sensor_value_to_double(&gyro_z);
    k_mutex_unlock(&sensor_data_mutex);
}

/**
 * @brief Initialize the IMU (accelerometer and gyroscope) sensor.
 *
 * This function checks whether the IMU device is ready and configures
 * the sampling frequency for both the accelerometer and gyroscope
 * channels to 104 Hz. After successful configuration, it triggers
 * an initial sample fetch using imu_sensor_sample_process() to
 * populate sensor_data.
 *
 * @return  0  Success, sensor ready and configured.  
 *         -1  Failure, device not ready or attribute configuration failed.
*/

int imu_sensor_init(void)
{

    if (!device_is_ready(imu_dev)) {
        LOG_ERR("sensor: device not ready.");
        return -1;
    }

    struct sensor_value odr_attr;

    /* set accel/gyro sampling frequency to 104 Hz */
    odr_attr.val1 = 104;
    odr_attr.val2 = 0;

    if (sensor_attr_set(imu_dev, SENSOR_CHAN_ACCEL_XYZ, SENSOR_ATTR_SAMPLING_FREQUENCY, &odr_attr) < 0) {
        LOG_ERR("Cannot set sampling frequency for accelerometer.");
        return -1;
    }

    if (sensor_attr_set(imu_dev, SENSOR_CHAN_GYRO_XYZ, SENSOR_ATTR_SAMPLING_FREQUENCY, &odr_attr) < 0) {
        LOG_ERR("Cannot set sampling frequency for gyro.");
        return -1;
    }

    imu_sensor_sample_process();
    return 0;
}
```

## src/imu_sensor.h
```c
/**
 * @file imu_sensor.h
 * @brief Interface for IMU (Inertial Measurement Unit) sensor handling.
 *
 * This header provides the function declarations for initializing
 * and processing samples from the IMU sensor. It ensures modular
 * and consistent integration of IMU sensor data collection in
 * embedded applications.
 *
 * @date 15-08-2025
 * @author Parthrajsinh Vala
*/

#ifndef IMU_SENSOR_H
#define IMU_SENSOR_H

/**
 * @brief Process a new IMU sensor sample.
 *
 * This function should be called whenever a new IMU sensor
 * measurement is available. It handles acquisition, filtering,
 * and preparing the data for further use or storage.
*/

void imu_sensor_sample_process(void);

/**
 * @brief Initialize the IMU sensor.
 *
 * Sets up the IMU sensor hardware, configures registers,
 * and prepares it for sampling operations.
 *
 * @return int 0 on success, negative error code on failure.
*/

int imu_sensor_init(void);

#endif /* IMU_SENSOR_H */
```

## src/pressure_sensor.h
```c
/**
 * @file pressure_sensor.h
 * @brief Interface for the pressure sensor driver.
 *
 * This header provides function declarations for initializing
 * the pressure sensor and processing sensor samples.
 */

#ifndef PRESSURE_SENSOR_H
#define PRESSURE_SENSOR_H

/**
 * @brief Process a pressure sensor sample.
 *
 * Reads raw data from the pressure sensor, applies any necessary
 * conversions or filtering, and makes the processed data available
 * for logging or further use.
 *
 * @date 15-08-2025
 * @author Parthrajsinh Vala
*/

void pressure_sensor_process_sample(void);

/**
 * @brief Initialize the pressure sensor.
 *
 * Configures the pressure sensor hardware and prepares it for use.
 *
 * @return int 0 if initialization is successful, negative error code otherwise.
*/

int pressure_sensor_init(void);

#endif /* PRESSURE_SENSOR_H */
```

## src/sensor_shared.c
```c
/**
 * @file sensor_share.c
 * @brief Shared sensor data handling module.
 *
 * This module defines the global sensor data structure and the
 * synchronization mechanism used to protect concurrent access.
 *
 * It provides a shared instance of `sensor_data_t` along with a
 * Zephyr mutex to ensure thread-safe operations when reading or
 * updating sensor data across multiple threads.
 *
 * @date 15-08-2025
 * @author Parthrajsinh Vala
*/

//==============================================================================
// Includes
//==============================================================================

#include "sensor_shared.h"

//==============================================================================
// Global Variables
//==============================================================================

/** 
 * @var sensor_data
 * @brief Global structure holding the latest sensor readings.
 *
 * This instance of ::sensor_data_t stores the most recent values 
 * fetched from all onboard sensors (temperature, humidity, pressure, 
 * accelerometer, gyroscope, etc.).  
 * 
 * It is shared across application modules and protected by 
 * ::sensor_data_mutex to ensure thread-safe access.
 */
struct sensor_data_t sensor_data;

/**
 * @var sensor_data_mutex
 * @brief Mutex for synchronizing access to ::sensor_data.
 *
 * This Zephyr kernel mutex ensures that only one thread at a time 
 * can read or update ::sensor_data, preventing race conditions and 
 * data corruption in multi-threaded environments.
 */
struct k_mutex sensor_data_mutex;
```

## src/sensor_shared.h
```c
/**
 * @file sensor_shared.h
 * @brief Shared data structures and synchronization primitives for sensor modules.
 *
 * This header defines the common sensor data structure used across
 * temperature, humidity, pressure, and IMU sensor modules. It also
 * declares a global mutex to ensure thread-safe access to sensor data.
 *
 * @date 15-08-2025
 * @author Parthrajsinh Vala
*/

#ifndef SENSOR_SHARED_H
#define SENSOR_SHARED_H

#include <zephyr/kernel.h>

/**
 * @struct sensor_data_t
 * @brief Structure to hold all sensor readings.
 *
 * This structure contains measurements from multiple sensors:
 * - Temperature and humidity
 * - Barometric pressure
 * - Accelerometer (X, Y, Z)
 * - Gyroscope (X, Y, Z)
*/

struct sensor_data_t {
    float temperature; /* Temperature reading in degrees Celsius. */
    float humidity;    /* Humidity reading in percentage (%RH). */
    float pressure;    /* Pressure reading in hPa (hectopascal). */
    float accel_x;     /* Acceleration in X-axis. */
    float accel_y;     /* Acceleration in Y-axis. */
    float accel_z;     /* Acceleration in Z-axis. */
    float gyro_x;      /* Gyroscope reading in X-axis. */
    float gyro_y;      /* Gyroscope reading in Y-axis. */
    float gyro_z;      /* Gyroscope reading in Z-axis. */
};

/**
 * @brief Global sensor data instance.
 *
 * This variable holds the latest sensor readings.
 * Access must be synchronized using @ref sensor_data_mutex.
*/

extern struct sensor_data_t sensor_data;

/**
 * @brief Mutex for protecting access to @ref sensor_data.
 *
 * Ensures thread-safe updates and reads of sensor data.
*/

extern struct k_mutex sensor_data_mutex;

#endif /* SENSOR_SHARED_H */
```

## src/sensor_storage.c
```c
/**
 * @file sensor_storage.c
 * @brief Logs the data to file in littlefs partition.
 *
 * This file provides the functionality of logging the data 
 * in the shared buffer of sensors to a file created in a little-fs 
 * partition.
 *
 * @date 15-08-2025
 * @author Parthrajsinh Vala
*/

//==============================================================================
// Includes
//==============================================================================

#include "sensor_shared.h"
#include <zephyr/fs/fs.h>
#include <zephyr/logging/log.h>
#include <zephyr/storage/flash_map.h>
#include <stdio.h>

//==============================================================================
// Logging Module Register
//==============================================================================

LOG_MODULE_REGISTER(sensor_storage);

//==============================================================================
// Configuration Constants
//==============================================================================

/** Path to the file where sensor data will be stored */
#define SENSOR_DATA_FILE "/lfs/SensorData"   // Sensor data file path in LittleFS

/** Maximum size of the line buffer for formatted sensor data */
#define LINE_BUFFER_SIZE 256                 // Buffer size for writing one line

//==============================================================================
// Function Definitions
//==============================================================================

/**
 * @brief Save sensor data to LittleFS storage.
 *
 * This function formats the given sensor data into a human-readable string
 * with uptime information and appends it to the file defined by 
 * ::SENSOR_DATA_FILE in the LittleFS filesystem.
 *
 * The data includes temperature, humidity, pressure, accelerometer 
 * (X, Y, Z), and gyroscope (X, Y, Z) readings. A timestamp in seconds 
 * since system start is prepended to each entry.
 *
 * @param[in] data Pointer to a ::sensor_data_t structure containing the 
 *                 latest sensor readings.
 *
 * @retval  0        Success, data was written to the file.
 * @retval -EINVAL   Failure, buffer formatting error (data too large).
 * @retval <0        Failure, filesystem-related error (see return code).
*/

int littlefs_save_sensor_data(const struct sensor_data_t *data)
{
    struct fs_file_t file;
    int rc;
    char line_buffer[LINE_BUFFER_SIZE];
    
    /* Get uptime in seconds */
    uint64_t uptime_sec = k_uptime_get() / 1000;


    int len = snprintf(line_buffer, LINE_BUFFER_SIZE,
                       "[%llu s] Temperature: %.2f, Humidity: %.2f, Pressure: %.2f, "
                       "Accel X: %.2f, Accel Y: %.2f, Accel Z: %.2f, "
                       "Gyro X: %.2f, Gyro Y: %.2f, Gyro Z: %.2f\n",uptime_sec,
                       (double)data->temperature, (double)data->humidity, (double)data->pressure,
                       (double)data->accel_x, (double)data->accel_y, (double)data->accel_z,
                       (double)data->gyro_x, (double)data->gyro_y, (double)data->gyro_z);

    if (len < 0 || len >= LINE_BUFFER_SIZE) {
        LOG_ERR("Failed to format sensor data line");
        return -EINVAL;
    }

    fs_file_t_init(&file);
    LOG_INF("Saving sensor data to LittleFS");

    rc = fs_open(&file, SENSOR_DATA_FILE, FS_O_CREATE | FS_O_WRITE | FS_O_APPEND);
    if (rc < 0) {
        LOG_ERR("fs_open() Failed (error: %d)", rc);
        return rc;
    }

    rc = fs_write(&file, line_buffer, len);
    if (rc < 0) {
        LOG_ERR("fs_write() Failed (error: %d)", rc);
        fs_close(&file);
        return rc;
    }

    fs_close(&file);
    LOG_INF("Sensor data saved successfully");

    
    return 0;
}

/**
 * @brief Reads and prints sensor data from LittleFS.
 *
 * This function opens the sensor data file stored in LittleFS,
 * reads its contents in chunks, and prints them to the console.
 *
 * @return int
 * - 0 on success
 * - Negative error code if file open or read fails
*/

int littlefs_read_sensor_data(void)
{
    struct fs_file_t file;
    char buf[128];
    int rc;

    fs_file_t_init(&file);
    rc = fs_open(&file, SENSOR_DATA_FILE, FS_O_READ);
    if (rc < 0) {
        LOG_ERR("Failed to open file for reading (err %d)", rc);
        return rc;
    }

    LOG_INF("Reading data from %s", SENSOR_DATA_FILE);

    while ((rc = fs_read(&file, buf, sizeof(buf) - 1)) > 0) {
        buf[rc] = '\0';       /* Null terminate so it prints cleanly */
        printk("%s", buf);    /* Print directly to console */
    }

    fs_close(&file);
    return 0;
}
```

## src/sensor_storage.h
```c
/**
 * @file sensor_storage.h
 * @brief Interface for saving and reading sensor data using LittleFS.
 *
 * This header provides functions to store and retrieve sensor data
 * in a LittleFS-backed file system for persistent storage.
 * 
 * @date 15-08-2025
 * @author Parthrajsinh Vala
*/

#ifndef SENSOR_STORAGE_H
#define SENSOR_STORAGE_H

/**
 * @brief Save sensor data to LittleFS.
 *
 * This function stores the given sensor data structure into persistent storage.
 * Each call appends or writes sensor readings for later retrieval.
 *
 * @param[in] data Pointer to the sensor_data_t structure containing sensor readings.
 * @retval 0 on success.
 * @retval -errno on failure (standard error codes).
*/

int littlefs_save_sensor_data(const struct sensor_data_t *data);

/**
 * @brief Read sensor data from LittleFS.
 *
 * This function reads previously saved sensor data from persistent storage.
 * The implementation may log or print the results depending on configuration.
 *
 * @retval 0 on success.
 * @retval -errno on failure (standard error codes).
*/

int littlefs_read_sensor_data();

#endif /* SENSOR_STORAGE_H */
```
